## targets/rb5009/fluxwan-rb5009.its
```
/dts-v1/;

/ {
	description = "FluxWAN Embedded OS for MikroTik RB5009 (ARM64)";
	#address-cells = <1>;

	images {
		kernel-1 {
			description = "FluxWAN Linux LTS 6.6 Kernel (ARM64)";
			data = /incbin/("Image.gz");
			type = "kernel";
			arch = "arm64";
			os = "linux";
			compression = "gzip";
			load = <0x80000>;
			entry = <0x80000>;
			hash-1 {
				algo = "sha256";
			};
		};

		fdt-1 {
			description = "MikroTik RB5009UG+S+IN Device Tree";
			data = /incbin/("armada-7040-rb5009.dtb");
			type = "flat_dt";
			arch = "arm64";
			compression = "none";
			load = <0x1000000>;
			hash-1 {
				algo = "sha256";
			};
		};

		ramdisk-1 {
			description = "FluxWAN Embedded Musl ARM64 RootFS / Initramfs";
			data = /incbin/("initramfs-fluxwan-arm64.cpio.gz");
			type = "ramdisk";
			arch = "arm64";
			os = "linux";
			compression = "gzip";
			load = <0x2000000>;
			hash-1 {
				algo = "sha256";
			};
		};
	};

	configurations {
		default = "config-1";

		config-1 {
			description = "Boot FluxWAN on MikroTik RB5009";
			kernel = "kernel-1";
			fdt = "fdt-1";
			ramdisk = "ramdisk-1";
			hash-1 {
				algo = "sha256";
			};
		};
	};
};
```
